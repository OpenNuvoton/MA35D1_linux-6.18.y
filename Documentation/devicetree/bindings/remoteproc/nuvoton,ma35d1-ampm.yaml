## Documentation/devicetree/bindings/remoteproc/nuvoton,ma35d1-ampm.yaml
```yaml
# SPDX-License-Identifier: (GPL-2.0-only OR BSD-2-Clause)
%YAML 1.2
---
$id: http://devicetree.org/schemas/remoteproc/nuvoton,ma35d1-ampm.yaml#
$schema: http://devicetree.org/meta-schemas/core.yaml#

title: Nuvoton MA35D1 AMP-M rpmsg controller (hwsem-based IPI)

maintainers:
  - Joey Lu <yclu4@nuvoton.com>

description:
  The MA35D1 AMP-M driver provides an rpmsg communication channel between
  the Cortex-A35 Linux host and the Cortex-M4 remote core. Inter-processor
  interrupts are signalled through a pair of hardware spinlock (hwsem)
  channels. The A35 host acquires and immediately releases the TX hwsem
  entry to pulse the M4; the M4 does the same on the RX channel to signal
  the A35. The driver registers an IRQ on the hwsem interrupt line to
  receive inbound notifications.

  The shared memory layout is described by a resource table written by the
  M4 firmware into the reserved-memory region at boot. The driver
  periodically polls for the resource table to appear (500 ms delayed work)
  and parses vring offsets, buffer sizes, and channel naming space on first
  successful sync.

  Supported on MA35D1 only. For MA35D0 and MA35H0, use the timer-based
  AMP driver (nuvoton,ma35d0-amp or nuvoton,ma35h0-amp).

properties:
  compatible:
    const: nuvoton,ma35d1-ampm

  memory-region:
    maxItems: 1
    description:
      Phandle to a reserved-memory node shared between the A35 host and
      the M4 remote core. The M4 firmware writes a resource table at the
      start of this region describing vring layout and buffer sizes.

  rxipi:
    $ref: /schemas/types.yaml#/definitions/phandle-array
    items:
      - items:
          - description: Phandle to the hwsem (hardware spinlock) controller.
          - description: >
              hwsem channel index used as the inbound IPI signal. The A35
              driver enables interrupts on this channel and waits for the
              M4 to acquire/release it as a notification pulse. Typically
              channel 6.
            minimum: 0
    description:
      Phandle with one argument (hwsem channel index) specifying the
      hardware spinlock entry used by the remote M4 core to signal the
      A35 host. Parsed with "#hwsem-cells" specifier.

  txipi:
    $ref: /schemas/types.yaml#/definitions/phandle-array
    items:
      - items:
          - description: Phandle to the hwsem (hardware spinlock) controller.
          - description: >
              hwsem channel index used as the outbound IPI signal. The A35
              driver acquires and immediately releases this channel to pulse
              the M4 interrupt line. Typically channel 7.
            minimum: 0
    description:
      Phandle with one argument (hwsem channel index) specifying the
      hardware spinlock entry used by the A35 host to signal the remote
      M4 core. Parsed with "#hwsem-cells" specifier.

required:
  - compatible
  - memory-region
  - rxipi
  - txipi

additionalProperties: false

examples:
  - |
    ampm: ampm {
        compatible = "nuvoton,ma35d1-ampm";
        memory-region = <&rpmsg_buf>;
        rxipi = <&hwsem 6>;
        txipi = <&hwsem 7>;
    };
```

## Documentation/devicetree/bindings/remoteproc/nuvoton,ma35d1-rproc.yaml
```yaml
# SPDX-License-Identifier: (GPL-2.0-only OR BSD-2-Clause)
%YAML 1.2
---
$id: http://devicetree.org/schemas/remoteproc/nuvoton,ma35d1-rproc.yaml#
$schema: http://devicetree.org/meta-schemas/core.yaml#

title: Nuvoton MA35D1 Cortex-M4 Remote Processor

maintainers:
  - Joey Lu <yclu4@nuvoton.com>

description:
  The MA35D1 remote processor driver controls the on-chip Cortex-M4
  co-processor using the Linux remoteproc framework. The driver loads
  an ELF firmware image into the M4's SRAM (mapped at physical address
  0x24000000, 128 KiB) and optionally into a DDR reserved-memory region
  for larger images that span both memories.

  The M4 is held in reset via the system reset controller and released
  by the driver on rproc start. Firmware loading is performed by a custom
  ELF segment loader that handles SRAM-only, DDR-only, and split
  SRAM+DDR segments.

  The rpmsg communication channel (AMP or AMP-M) is a separate device
  node and is not part of this binding.

  Supported on MA35D1 only.

properties:
  compatible:
    const: nuvoton,ma35d1-rproc

  resets:
    maxItems: 1
    description:
      Reset control for the Cortex-M4 core. The driver asserts this
      reset before loading firmware and deasserts it to start execution.

  memory-region:
    maxItems: 1
    description:
      Phandle to a reserved DDR memory region used as the M4 DDR load
      area. The driver maps this region with MEMREMAP_WT and uses it
      for ELF segments whose physical address falls at or beyond the
      SRAM size boundary (0x20000).

required:
  - compatible
  - resets
  - memory-region

additionalProperties: false

examples:
  - |
    #include <dt-bindings/reset/nuvoton,ma35d1-reset.h>

    rproc {
        compatible = "nuvoton,ma35d1-rproc";
        resets = <&reset MA35D1_RESET_CM4>;
        memory-region = <&rproc_buf>;
    };
```

## Documentation/devicetree/bindings/rng/nuvoton,ma35d1-trng-optee.yaml
```yaml
# SPDX-License-Identifier: (GPL-2.0-only OR BSD-2-Clause)
%YAML 1.2
---
$id: http://devicetree.org/schemas/rng/nuvoton,ma35d1-trng-optee.yaml#
$schema: http://devicetree.org/meta-schemas/core.yaml#

title: Nuvoton MA35D1 OP-TEE True Random Number Generator

maintainers:
  - Nuvoton Technology Corporation <cwweng@nuvoton.com>

description:
  The Nuvoton MA35D1 OP-TEE TRNG provides access to the hardware
  random number generator through an OP-TEE Trusted Application.

properties:
  compatible:
    enum:
      - nuvoton,ma35d1-trng-optee
      - nuvoton,ma35d0-trng-optee

required:
  - compatible

additionalProperties: false

examples:
  - |
    rng {
        compatible = "nuvoton,ma35d1-trng-optee";
    };
...
```

## Documentation/devicetree/bindings/rng/nuvoton,ma35d1-trng.yaml
```yaml
# SPDX-License-Identifier: (GPL-2.0-only OR BSD-2-Clause)
%YAML 1.2
---
$id: http://devicetree.org/schemas/rng/nuvoton,ma35d1-trng.yaml#
$schema: http://devicetree.org/meta-schemas/core.yaml#

title: Nuvoton MA35D1 True Random Number Generator

maintainers:
  - Nuvoton Technology Corporation <cwweng@nuvoton.com>

description:
  The Nuvoton MA35D1 TRNG is a hardware random number generator
  found on MA35D1, MA35D0 and MA35H0 SoCs.

properties:
  compatible:
    enum:
      - nuvoton,ma35d1-trng
      - nuvoton,ma35d0-trng
      - nuvoton,ma35h0-trng

  reg:
    maxItems: 1

required:
  - compatible
  - reg

additionalProperties: false

examples:
  - |
    trng: rng@404d0000 {
        compatible = "nuvoton,ma35d1-trng";
        reg = <0x404d0000 0x1000>;
    };
...
```

## Documentation/devicetree/bindings/rpmsg/nuvoton,ma35d1-rpmsg.yaml
```yaml
# SPDX-License-Identifier: (GPL-2.0-only OR BSD-2-Clause)
%YAML 1.2
---
$id: http://devicetree.org/schemas/rpmsg/nuvoton,ma35d1-rpmsg.yaml#
$schema: http://devicetree.org/meta-schemas/core.yaml#

title: Nuvoton MA35D1 RPMsg Transport

maintainers:
  - Chi-Wen Weng <cwweng@nuvoton.com>

properties:
  compatible:
    const: nuvoton,ma35d1-rpmsg

  mboxes:
    maxItems: 1

  memory-region:
    maxItems: 1

required:
  - compatible
  - mboxes
  - memory-region

additionalProperties: false

examples:
  - |
    rpmsg {
        compatible = "nuvoton,ma35d1-rpmsg";
        mboxes = <&wormhole 2>;
        memory-region = <&rpmsg_buf>;
    };
```

## Documentation/devicetree/bindings/serial/nuvoton,ma35d1-puart.yaml
```yaml
# SPDX-License-Identifier: (GPL-2.0-only OR BSD-2-Clause)
%YAML 1.2
---
$id: http://devicetree.org/schemas/serial/nuvoton,ma35d1-puart.yaml#
$schema: http://devicetree.org/meta-schemas/core.yaml#

title: Nuvoton MA35D1 PDMA UART

maintainers:
  - Chi-Wen Weng <cwweng@nuvoton.com>

properties:
  compatible:
    const: nuvoton,ma35d1-puart

  reg:
    maxItems: 1

  port-number:
    $ref: /schemas/types.yaml#/definitions/uint32

  pdma-port:
    $ref: /schemas/types.yaml#/definitions/uint32

  pdma-tx-ch:
    $ref: /schemas/types.yaml#/definitions/uint32

  pdma-rx-ch:
    $ref: /schemas/types.yaml#/definitions/uint32

  interrupts:
    minItems: 2
    maxItems: 2

  interrupt-names:
    items:
      - const: puart_uart
      - const: puart_dma

  clocks:
    minItems: 2
    maxItems: 2

  clock-names:
    items:
      - const: puart_clk
      - const: pdma_clk

required:
  - compatible
  - reg
  - port-number
  - pdma-port
  - pdma-tx-ch
  - pdma-rx-ch
  - interrupts
  - interrupt-names
  - clocks
  - clock-names

additionalProperties: false

examples:
  - |
    serial@40710000 {
        compatible = "nuvoton,ma35d1-puart";
        reg = <0x40710000 0x10000>;
        port-number = <1>;
        pdma-port = <0>;
        pdma-tx-ch = <0>;
        pdma-rx-ch = <1>;
        interrupts = <60>, <18>;
        interrupt-names = "puart_uart", "puart_dma";
        clocks = <&clk 1>, <&clk 2>;
        clock-names = "puart_clk", "pdma_clk";
    };
```

## Documentation/devicetree/bindings/serial/nuvoton,ma35d1-uart.yaml
```yaml
# SPDX-License-Identifier: (GPL-2.0-only OR BSD-2-Clause)
%YAML 1.2
---
$id: http://devicetree.org/schemas/serial/nuvoton,ma35d1-uart.yaml#
$schema: http://devicetree.org/meta-schemas/core.yaml#

title: Nuvoton MA35 Series UART Controller

description: |
  This describes the devicetree bindings for the UART controller found
  in Nuvoton MA35D1, MA35H0, and MA35D0 SoCs.

maintainers:
  - Nuvoton Technology Corporation <cwweng@nuvoton.com>

properties:
  compatible:
    enum:
      - nuvoton,ma35d1-uart
      - nuvoton,ma35h0-uart
      - nuvoton,ma35d0-uart

  reg:
    maxItems: 1

  interrupts:
    maxItems: 1

  clocks:
    maxItems: 1

  ma35d1-console:
    description: |
      Indicates that this UART instance is used as the system console.
    type: boolean

  port-number:
    description: |
      The port number assigned to this UART instance.
    $ref: /schemas/types.yaml#/definitions/uint32
    minimum: 0
    maximum: 16

  pdma-enable:
    description: |
      Indicates whether PDMA (Peripheral DMA) is enabled for this UART
      instance. 0 means disabled, 1 means enabled.
    $ref: /schemas/types.yaml#/definitions/uint32
    enum: [0, 1]

  dmas:
    minItems: 1
    maxItems: 2

  dma-names:
    minItems: 1
    maxItems: 2
    items:
      enum:
        - tx
        - rx

  nuvoton,pdma-reqsel-tx:
    description: PDMA request selector for UART transmit.
    $ref: /schemas/types.yaml#/definitions/uint32
    enum: [4, 6, 8, 10, 12, 14, 16, 18, 20, 22, 24, 26, 28, 30,
           32, 34, 36]

  nuvoton,pdma-reqsel-rx:
    description: PDMA request selector for UART receive.
    $ref: /schemas/types.yaml#/definitions/uint32
    enum: [5, 7, 9, 11, 13, 15, 17, 19, 21, 23, 25, 27, 29, 31,
           33, 35, 37]

  wakeup-enable:
    description: |
      Enables specific wakeup sources while the UART is in low-power
      mode: <cts-wakeup fifo-threshold-wakeup fifo-timeout-wakeup>.
      Each cell is 0 (disabled) or 1 (enabled).
    $ref: /schemas/types.yaml#/definitions/uint32-array
    minItems: 3
    maxItems: 3
    items:
      enum: [0, 1]

  fifo-threshold:
    description: |
      FIFO threshold value used only when fifo-threshold-wakeup is
      enabled in wakeup-enable. Valid values are 1, 4, 8, 14, or 30
      bytes.
    $ref: /schemas/types.yaml#/definitions/uint32
    enum: [1, 4, 8, 14, 30]

required:
  - compatible
  - reg
  - interrupts
  - clocks
  - port-number

dependencies:
  dmas: [dma-names]
  dma-names: [dmas]

allOf:
  - $ref: serial.yaml#
  - if:
      properties:
        pdma-enable:
          const: 1
      required:
        - pdma-enable
    then:
      required:
        - dmas
        - dma-names
        - nuvoton,pdma-reqsel-tx
        - nuvoton,pdma-reqsel-rx

unevaluatedProperties: false

examples:
  - |
    #include <dt-bindings/interrupt-controller/arm-gic.h>
    serial@40700000 {
        compatible = "nuvoton,ma35d1-uart";
        reg = <0x0 0x40700000 0x0 0x10000>;
        ma35d1-console;
        interrupts = <GIC_SPI 59 IRQ_TYPE_LEVEL_HIGH>;
        clocks = <&clk UART0_GATE>;
        port-number = <0>;
        pdma-enable = <0>;
        status = "okay";
    };
  - |
    #include <dt-bindings/dma/nuvoton,ma35-pdma.h>
    #include <dt-bindings/interrupt-controller/arm-gic.h>
    serial@40710000 {
        compatible = "nuvoton,ma35d1-uart";
        reg = <0x0 0x40710000 0x0 0x10000>;
        interrupts = <GIC_SPI 60 IRQ_TYPE_LEVEL_HIGH>;
        clocks = <&clk UART1_GATE>;
        port-number = <1>;
        dmas = <&pdma2 2>, <&pdma3 3>;
        dma-names = "tx", "rx";
        nuvoton,pdma-reqsel-tx = <MA35_PDMA_REQ_UART1_TX>;
        nuvoton,pdma-reqsel-rx = <MA35_PDMA_REQ_UART1_RX>;
        pdma-enable = <1>;
        status = "disabled";
    };
```

## Documentation/devicetree/bindings/sound/nuvoton,ma35d0-audio.yaml
```yaml
# SPDX-License-Identifier: (GPL-2.0-only OR BSD-2-Clause)
%YAML 1.2
---
$id: http://devicetree.org/schemas/sound/nuvoton,ma35d0-audio.yaml#
$schema: http://devicetree.org/meta-schemas/core.yaml#

title: Nuvoton MA35D0 Legacy Audio Card and PCM Platform

maintainers:
  - Chi-Wen Weng <cwweng@nuvoton.com>

properties:
  compatible:
    enum:
      - nuvoton,ma35d0-audio
      - nuvoton,ma35d0-audio-pcm
  i2s-controller:
    $ref: /schemas/types.yaml#/definitions/phandle
  i2s-platform:
    $ref: /schemas/types.yaml#/definitions/phandle

required:
  - compatible

allOf:
  - if:
      properties:
        compatible:
          const: nuvoton,ma35d0-audio
    then:
      required:
        - i2s-controller
        - i2s-platform

additionalProperties: false
```
