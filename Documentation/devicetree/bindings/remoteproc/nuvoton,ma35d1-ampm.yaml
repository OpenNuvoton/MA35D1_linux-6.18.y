## Documentation/devicetree/bindings/sound/nuvoton,ma35d1.yaml
```yaml
# SPDX-License-Identifier: (GPL-2.0-only OR BSD-2-Clause)
%YAML 1.2
---
$id: http://devicetree.org/schemas/sound/nuvoton,ma35d1.yaml#
$schema: http://devicetree.org/meta-schemas/core.yaml#

title: Nuvoton MA35 Series I2S Controller

maintainers:
  - Chi-Wen Weng <cwweng@nuvoton.com>

description: |
  The Nuvoton MA35D0, MA35D1, and MA35H0 I2S controllers provide full-duplex serial audio
  interfaces for communicating with external audio codecs. They support
  I2S, left-justified, and right-justified formats, master and slave modes,
  and DMA-based playback and capture.

allOf:
  - $ref: dai-common.yaml#

properties:
  compatible:
    enum:
      - nuvoton,ma35d0-i2s
      - nuvoton,ma35d1-i2s
      - nuvoton,ma35h0-i2s

  reg:
    maxItems: 1

  interrupts:
    maxItems: 1

  clocks:
    maxItems: 1

  resets:
    maxItems: 1

  dmas:
    items:
      - description: DMA channel for audio playback
      - description: DMA channel for audio capture

  dma-names:
    items:
      - const: tx
      - const: rx

  pdma_reqsel_tx:
    $ref: /schemas/types.yaml#/definitions/uint32
    enum: [86, 88]
    description:
      MA35 PDMA request-selection value for the I2S transmit request.

  pdma_reqsel_rx:
    $ref: /schemas/types.yaml#/definitions/uint32
    enum: [87, 89]
    description:
      MA35 PDMA request-selection value for the I2S receive request.

  powerdown-gpios:
    maxItems: 1
    description:
      GPIO controlling the board audio power-down signal. The asserted
      state powers down the external audio path.

  '#sound-dai-cells':
    const: 0

required:
  - compatible
  - reg
  - interrupts
  - clocks
  - resets
  - dmas
  - dma-names
  - pdma_reqsel_tx
  - pdma_reqsel_rx
  - '#sound-dai-cells'

unevaluatedProperties: false

examples:
  - |
    #include <dt-bindings/clock/nuvoton,ma35d1-clk.h>
    #include <dt-bindings/dma/nuvoton,ma35-pdma.h>
    #include <dt-bindings/interrupt-controller/arm-gic.h>
    #include <dt-bindings/reset/nuvoton,ma35d1-reset.h>

    i2s@40480000 {
        compatible = "nuvoton,ma35d1-i2s";
        reg = <0x40480000 0x10000>;
        interrupts = <GIC_SPI 70 IRQ_TYPE_LEVEL_HIGH>;
        clocks = <&clk I2S0_GATE>;
        resets = <&reset MA35D1_RESET_I2S0>;

        dmas = <&pdma2 0>, <&pdma2 1>;
        dma-names = "tx", "rx";

        pdma_reqsel_tx = <MA35_PDMA_REQ_I2S0_TX>;
        pdma_reqsel_rx = <MA35_PDMA_REQ_I2S0_RX>;

        #sound-dai-cells = <0>;
    };
```

## Documentation/devicetree/bindings/spi/nuvoton,ma35d1-qspi.yaml
```yaml
# SPDX-License-Identifier: (GPL-2.0-only OR BSD-2-Clause)
%YAML 1.2
---
$id: http://devicetree.org/schemas/spi/nuvoton,ma35d1-qspi.yaml#
$schema: http://devicetree.org/meta-schemas/core.yaml#

title: Nuvoton MA35 Series Quad SPI Controller

maintainers:
  - Chi-Wen Weng <cwweng@nuvoton.com>

description: |
  The Quad SPI controller in the Nuvoton MA35D0, MA35D1, and MA35H0
  SoCs supports standard SPI transfers and SPI memory operations in
  single, dual, and quad I/O modes. The three SoCs use the same QSPI
  register layout and programming model.

allOf:
  - $ref: /schemas/spi/spi-controller.yaml#

properties:
  compatible:
    enum:
      - nuvoton,ma35d0-qspi
      - nuvoton,ma35d1-qspi
      - nuvoton,ma35h0-qspi

  reg:
    maxItems: 1

  interrupts:
    maxItems: 1

  clocks:
    maxItems: 1


  dmas:
    minItems: 2
    maxItems: 2

  dma-names:
    items:
      - const: tx
      - const: rx

  nuvoton,pdma-reqsel-rx:
    $ref: /schemas/types.yaml#/definitions/uint32
    enum: [55, 57]
    description:
      PDMA request selector value used for QSPI receive transfers.

  nuvoton,pdma-reqsel-tx:
    $ref: /schemas/types.yaml#/definitions/uint32
    enum: [54, 56]
    description:
      PDMA request selector value used for QSPI transmit transfers.

  num-cs:
    maximum: 2
    default: 2

dependencies:
  dmas:
    - dma-names
    - nuvoton,pdma-reqsel-rx
    - nuvoton,pdma-reqsel-tx
  dma-names:
    - dmas
  nuvoton,pdma-reqsel-rx:
    - dmas
  nuvoton,pdma-reqsel-tx:
    - dmas

required:
  - compatible
  - reg
  - clocks

unevaluatedProperties: false

examples:
  - |
    #include <dt-bindings/interrupt-controller/arm-gic.h>
    #include <dt-bindings/clock/nuvoton,ma35d1-clk.h>
    #include <dt-bindings/dma/nuvoton,ma35-pdma.h>

    soc {
        #address-cells = <2>;
        #size-cells = <2>;

        spi@40680000 {
            compatible = "nuvoton,ma35d1-qspi";
            reg = <0 0x40680000 0 0x100>;
            interrupts = <GIC_SPI 57 IRQ_TYPE_LEVEL_HIGH>;
            clocks = <&clk QSPI0_GATE>;
            dmas = <&pdma1 0>, <&pdma1 1>;
            dma-names = "tx", "rx";
            nuvoton,pdma-reqsel-tx = <MA35_PDMA_REQ_QSPI0_TX>;
            nuvoton,pdma-reqsel-rx = <MA35_PDMA_REQ_QSPI0_RX>;
            #address-cells = <1>;
            #size-cells = <0>;
        };
    };
...
```

## Documentation/devicetree/bindings/spi/nuvoton,ma35d1-spi.yaml
```yaml
# SPDX-License-Identifier: (GPL-2.0-only OR BSD-2-Clause)
%YAML 1.2
---
$id: http://devicetree.org/schemas/spi/nuvoton,ma35d1-spi.yaml#
$schema: http://devicetree.org/meta-schemas/core.yaml#

title: Nuvoton MA35 Series SPI Controller

maintainers:
  - Chi-Wen Weng <cwweng@nuvoton.com>

description: |
  The Nuvoton MA35D0, MA35D1, and MA35H0 SoCs contain SPI controllers. Each controller supports
  full-duplex transfers, two native chip-select signals, 8- to 32-bit words,
  programmable clock polarity and phase, and optional PDMA transfers.

  This binding describes the controller operating in SPI master mode. The I2S
  function provided by the same hardware block is handled by a separate audio
  driver and binding.

allOf:
  - $ref: spi-controller.yaml#

properties:
  compatible:
    enum:
      - nuvoton,ma35d0-spi
      - nuvoton,ma35d1-spi
      - nuvoton,ma35h0-spi

  reg:
    maxItems: 1

  interrupts:
    maxItems: 1

  clocks:
    maxItems: 1

  dmas:
    minItems: 2
    maxItems: 2

  dma-names:
    items:
      - const: tx
      - const: rx

  nuvoton,pdma-reqsel-tx:
    $ref: /schemas/types.yaml#/definitions/uint32
    enum: [60, 62, 64, 66]
    description:
      MA35 PDMA request selector used for SPI transmit requests.

  nuvoton,pdma-reqsel-rx:
    $ref: /schemas/types.yaml#/definitions/uint32
    enum: [61, 63, 65, 67]
    description:
      MA35 PDMA request selector used for SPI receive requests.

  use_pdma:
    $ref: /schemas/types.yaml#/definitions/uint32
    enum: [0, 1]
    deprecated: true
    description: Legacy switch selecting interrupt or PDMA transfers.

  num_cs:
    $ref: /schemas/types.yaml#/definitions/uint32
    maximum: 2
    deprecated: true
    description: Legacy number of native chip selects.

  lsb:
    $ref: /schemas/types.yaml#/definitions/uint32
    enum: [0, 1]
    deprecated: true

  sleep:
    $ref: /schemas/types.yaml#/definitions/uint32
    deprecated: true

  txbitlen:
    $ref: /schemas/types.yaml#/definitions/uint32
    minimum: 1
    maximum: 32
    deprecated: true

  bus_num:
    $ref: /schemas/types.yaml#/definitions/uint32
    deprecated: true

  spimode:
    $ref: /schemas/types.yaml#/definitions/uint32
    maximum: 3
    deprecated: true

  mrxphase:
    $ref: /schemas/types.yaml#/definitions/uint32
    maximum: 15
    deprecated: true

  num-cs:
    const: 2
    default: 2

  cs-gpios: false

  spi-slave: false

required:
  - compatible
  - reg
  - interrupts
  - clocks
  - "#address-cells"
  - "#size-cells"

dependencies:
  dmas:
    - dma-names
    - nuvoton,pdma-reqsel-tx
    - nuvoton,pdma-reqsel-rx
  dma-names:
    - dmas
  nuvoton,pdma-reqsel-tx:
    - dmas
  nuvoton,pdma-reqsel-rx:
    - dmas

unevaluatedProperties: false

examples:
  - |
    #include <dt-bindings/clock/nuvoton,ma35d1-clk.h>
    #include <dt-bindings/dma/nuvoton,ma35-pdma.h>
    #include <dt-bindings/interrupt-controller/arm-gic.h>

    spi@40600000 {
        compatible = "nuvoton,ma35d1-spi";
        reg = <0x40600000 0x10000>;
        interrupts = <GIC_SPI 89 IRQ_TYPE_LEVEL_HIGH>;
        clocks = <&clk SPI0_GATE>;

        dmas = <&pdma1 4>, <&pdma1 5>;
        dma-names = "tx", "rx";
        nuvoton,pdma-reqsel-tx = <MA35_PDMA_REQ_SPI0_TX>;
        nuvoton,pdma-reqsel-rx = <MA35_PDMA_REQ_SPI0_RX>;

        num_cs = <2>;
        #address-cells = <1>;
        #size-cells = <0>;
    };
...
```

## Documentation/devicetree/bindings/thermal/nuvoton,ma35d1-tsen.yaml
```yaml
# SPDX-License-Identifier: (GPL-2.0-only OR BSD-2-Clause)
%YAML 1.2
---
$id: http://devicetree.org/schemas/thermal/nuvoton,ma35d1-tsen.yaml#
$schema: http://devicetree.org/meta-schemas/core.yaml#

title: Nuvoton MA35 Temperature Sensor

maintainers:
  - Nuvoton Technology Corporation <cwweng@nuvoton.com>

description:
  Temperature sensor for Nuvoton MA35D1, MA35D0 and MA35H0 SoCs. The
  sensor registers are located in the system controller register block.

properties:
  compatible:
    enum:
      - nuvoton,ma35d1-tsen
      - nuvoton,ma35d0-tsen
      - nuvoton,ma35h0-tsen

  nuvoton,ma35d1-sys:
    $ref: /schemas/types.yaml#/definitions/phandle
    description:
      Phandle to the MA35 system controller syscon register block.

  "#thermal-sensor-cells":
    const: 0

required:
  - compatible
  - nuvoton,ma35d1-sys
  - "#thermal-sensor-cells"

additionalProperties: false

examples:
  - |
    temperature-sensor {
        compatible = "nuvoton,ma35d1-tsen";
        nuvoton,ma35d1-sys = <&sys>;
        #thermal-sensor-cells = <0>;
    };
...
```

## Documentation/devicetree/bindings/usb/nuvoton,ma35d1-ehci.yaml
```yaml
# SPDX-License-Identifier: (GPL-2.0-only OR BSD-2-Clause)
%YAML 1.2
---
$id: http://devicetree.org/schemas/usb/nuvoton,ma35d1-ehci.yaml#
$schema: http://devicetree.org/meta-schemas/core.yaml#

title: Nuvoton MA35D1 EHCI Controller

maintainers:
  - Nuvoton Technology Corporation <cwweng@nuvoton.com>

properties:
  compatible:
    enum:
      - nuvoton,ma35d1-ehci
      - nuvoton,ma35d0-ehci
      - nuvoton,ma35h0-ehci

  reg:
    maxItems: 1

  interrupts:
    maxItems: 1

  clocks:
    maxItems: 1

  clock-names:
    items:
      - const: hsusbh0_gate

  nuvoton,sys:
    $ref: /schemas/types.yaml#/definitions/phandle
    description: Phandle to the system controller (SYS) registers.

  oc-active-level:
    $ref: /schemas/types.yaml#/definitions/uint32
    description: |
      Over-current detection active level.
      1: active-high
      0: active-low
    enum: [0, 1]

  nuvoton,rcalcode0:
    $ref: /schemas/types.yaml#/definitions/uint32
    description: Port 0 PHY internal resistor trim code.
    minimum: 0
    maximum: 15

  status: true

required:
  - compatible
  - reg
  - interrupts
  - clocks
  - clock-names
  - nuvoton,sys

additionalProperties: false

examples:
  - |
    #include <dt-bindings/interrupt-controller/arm-gic.h>
    #include <dt-bindings/clock/nuvoton,ma35d1-clk.h>

    ehci0: ehci@40140000 {
        compatible = "nuvoton,ma35d1-ehci";
        reg = <0x0 0x40140000 0x0 0x1000>;
        clocks = <&clk HUSBH0_GATE>;
        clock-names = "hsusbh0_gate";
        nuvoton,sys = <&sys>;
        interrupts = <GIC_SPI 33 IRQ_TYPE_LEVEL_HIGH>;
        oc-active-level = <0>;    /* 1: active-high; 0: active low */
        nuvoton,rcalcode0 = <7>;  /* Port 0 PHY Internal Resistor Trim Code (0 ~ 15) */
    };
```

## Documentation/devicetree/bindings/usb/nuvoton,ma35d1-ohci.yaml
```yaml
# SPDX-License-Identifier: (GPL-2.0-only OR BSD-2-Clause)
%YAML 1.2
---
$id: http://devicetree.org/schemas/usb/nuvoton,ma35d1-ohci.yaml#
$schema: http://devicetree.org/meta-schemas/core.yaml#

title: Nuvoton MA35D1 ohci Controller

maintainers:
  - Nuvoton Technology Corporation <cwweng@nuvoton.com>

properties:
  compatible:
    enum:
      - nuvoton,ma35d1-ohci
      - nuvoton,ma35d0-ohci
      - nuvoton,ma35h0-ohci

  reg:
    maxItems: 1

  interrupts:
    maxItems: 1

  clocks:
    maxItems: 1

  nuvoton,sys:
    $ref: /schemas/types.yaml#/definitions/phandle
    description: Phandle to the system controller (SYS) registers.

required:
  - compatible
  - reg
  - interrupts
  - clocks
  - nuvoton,sys

additionalProperties: false

examples:
  - |
    #include <dt-bindings/interrupt-controller/arm-gic.h>
    #include <dt-bindings/clock/nuvoton,ma35d1-clk.h>

    ohci0:ohci@40150000 {
      compatible = "nuvoton,ma35d1-ohci";
      reg = <0x0 0x40150000 0x0 0x1000>;
      clocks = <&clk HUSBH0_GATE>;
      nuvoton,sys = <&sys>;
      interrupts = <GIC_SPI 35 IRQ_TYPE_LEVEL_HIGH>;
    };
```

## Documentation/devicetree/bindings/watchdog/nuvoton,ma35d1-wwdt.yaml
```yaml
# SPDX-License-Identifier: (GPL-2.0-only OR BSD-2-Clause)
%YAML 1.2
---
$id: http://devicetree.org/schemas/watchdog/nuvoton,ma35d1-wwdt.yaml#
$schema: http://devicetree.org/meta-schemas/core.yaml#

title: Nuvoton MA35D1 Window Watchdog Timer

maintainers:
  - Nuvoton Technology Corporation <cwweng@nuvoton.com>

allOf:
  - $ref: watchdog.yaml#

properties:
  compatible:
    enum:
      - nuvoton,ma35d1-wwdt
      - nuvoton,ma35d0-wwdt
      - nuvoton,ma35h0-wwdt

  reg:
    maxItems: 1

  interrupts:
    maxItems: 1

  clocks:
    maxItems: 1

required:
  - compatible
  - reg
  - interrupts
  - clocks

unevaluatedProperties: false

examples:
  - |
    #include <dt-bindings/interrupt-controller/arm-gic.h>
    #include <dt-bindings/interrupt-controller/irq.h>
    #include <dt-bindings/clock/nuvoton,ma35d1-clk.h>
    soc {
        #address-cells = <2>;
        #size-cells = <2>;
        wwdt1: watchdog@40440100 {
          compatible = "nuvoton,ma35d1-wwdt";
          reg = <0x0 0x40440100 0x0 0x100>;
          interrupts = <GIC_SPI 44 IRQ_TYPE_LEVEL_HIGH>;
          clocks = <&clk WDT1_GATE>;
        };
    };
...
```

## drivers/media/platform/nuvoton/ma35d1/Kconfig
```kconfig
# SPDX-License-Identifier: GPL-2.0-only

config VIDEO_NUVOTON_VC8K
	bool "Nuvoton VC8000 video decoder driver"
	depends on (ARCH_MA35D1 || ARCH_MA35D0 || ARCH_MA35H0 || COMPILE_TEST)
	default y
	select VIDEO_DEV
	select VIDEO_V4L2
	select MEDIA_CONTROLLER
	select VIDEOBUF2_DMA_CONTIG
	select VIDEOBUF2_VMALLOC
	select V4L2_MEM2MEM_DEV
	help
	  Enable the Nuvoton MA35 Series VC8000 H.264 and JPEG decoder.

	  The open Linux interface is linked with a prebuilt VC8000 core and
	  built directly into the kernel image.
```

## drivers/thermal/nuvoton/Kconfig
```kconfig
# SPDX-License-Identifier: GPL-2.0-only
config MA35D1_THERMAL
	tristate "MA35D1 Temperature Sensor"
	depends on ARCH_MA35D1 || ARCH_MA35D0 || ARCH_MA35H0
	default y
	help
	  This enables the thermal sysfs driver for the TSENS device. It shows
	  up in Sysfs as a thermal zone.
```

## sound/soc/nuvoton/Kconfig
```kconfig
# SPDX-License-Identifier: GPL-2.0-only
config SND_SOC_NUVOTON
	tristate
	select REGMAP_MMIO

config SND_SOC_MA35D1
	tristate "ASoC support for Nuvoton MA35D1 chip"
	select SND_SOC_NUVOTON
	select SND_SOC_GENERIC_DMAENGINE_PCM
	help
	  This adds ASoC driver for Nuvoton MA35D1 boards
	  that can be used with other codecs.
	  Select Y if you have such device.
	  If unsure select "N".
```
