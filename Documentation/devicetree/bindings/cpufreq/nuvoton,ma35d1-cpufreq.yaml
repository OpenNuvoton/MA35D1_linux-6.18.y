## Documentation/devicetree/bindings/mfd/nuvoton,ma35-sysctrl.yaml
```yaml
# SPDX-License-Identifier: (GPL-2.0-only OR BSD-2-Clause)
%YAML 1.2
---
$id: http://devicetree.org/schemas/mfd/nuvoton,ma35-sysctrl.yaml#
$schema: http://devicetree.org/meta-schemas/core.yaml#

title: Nuvoton MA35 System Register Protection Controller

maintainers:
  - Chi-Wen Weng <cwweng@nuvoton.com>

properties:
  compatible:
    enum:
      - nuvoton,ma35d0-sysctrl
      - nuvoton,ma35d1-sysctrl
      - nuvoton,ma35h0-sysctrl

  nuvoton,ma35d0-sys:
    $ref: /schemas/types.yaml#/definitions/phandle
    description: Phandle to the corresponding MA35 system register syscon.

  nuvoton,ma35d1-sys:
    $ref: /schemas/types.yaml#/definitions/phandle
    description: Phandle to the corresponding MA35 system register syscon.

  nuvoton,ma35h0-sys:
    $ref: /schemas/types.yaml#/definitions/phandle
    description: Phandle to the corresponding MA35 system register syscon.

required:
  - compatible

allOf:
  - if:
      properties:
        compatible:
          const: nuvoton,ma35d0-sysctrl
    then:
      required: ["nuvoton,ma35d0-sys"]
  - if:
      properties:
        compatible:
          const: nuvoton,ma35d1-sysctrl
    then:
      required: ["nuvoton,ma35d1-sys"]
  - if:
      properties:
        compatible:
          const: nuvoton,ma35h0-sysctrl
    then:
      required: ["nuvoton,ma35h0-sys"]

additionalProperties: false

examples:
  - |
    sys-controller {
        compatible = "nuvoton,ma35d1-sysctrl";
        nuvoton,ma35d1-sys = <&sys>;
    };
```

## Documentation/devicetree/bindings/misc/nuvoton,ma35d0-misctrl.yaml
```yaml
# SPDX-License-Identifier: (GPL-2.0-only OR BSD-2-Clause)
%YAML 1.2
---
$id: http://devicetree.org/schemas/misc/nuvoton,ma35d0-misctrl.yaml#
$schema: http://devicetree.org/meta-schemas/core.yaml#

title: Nuvoton MA35D0 Misc Control Driver

maintainers:
  - Nuvoton Technology Corporation <cwweng@nuvoton.com>

description:
  Miscellaneous control interface for the Nuvoton MA35D0 SoC. The driver
  provides a misc device for issuing MA35D0 SiP service calls.

properties:
  compatible:
    const: nuvoton,ma35d0-misctrl

required:
  - compatible

additionalProperties: false

examples:
  - |
    misctrl {
        compatible = "nuvoton,ma35d0-misctrl";
    };
...
```

## Documentation/devicetree/bindings/misc/nuvoton,ma35d1-ebi.yaml
```yaml
# SPDX-License-Identifier: (GPL-2.0-only OR BSD-2-Clause)
%YAML 1.2
---
$id: http://devicetree.org/schemas/misc/nuvoton,ma35d1-ebi.yaml#
$schema: http://devicetree.org/meta-schemas/core.yaml#

title: Nuvoton MA35D1 EBI Controller

maintainers:
  - Nuvoton Technology Corporation <cwweng@nuvoton.com>

properties:
  compatible:
    enum:
      - nuvoton,ma35d1-ebi
      - nuvoton,ma35d0-ebi
      - nuvoton,ma35h0-ebi

  reg:
    maxItems: 1

  clocks:
    maxItems: 1

  bank:
    $ref: /schemas/types.yaml#/definitions/uint32
    enum: [0, 1, 2]
    description: |
      The memory bank number (0 to 2) of this EBI node.

  busmode:
    $ref: /schemas/types.yaml#/definitions/uint32
    enum: [0, 1]
    description: |
      Address/Data Bus Separate Mode.
      0: Disabled
      1: Enabled

  csactiveLevel:
    $ref: /schemas/types.yaml#/definitions/uint32
    enum: [0, 1]
    description: |
      Chip Select Active Level.
      0: Active Low
      1: Active High

  datawidth:
    $ref: /schemas/types.yaml#/definitions/uint32
    enum: [0, 1]
    description: |
      Bus data width.
      0: 8-bit
      1: 16-bit

  MCLKDIV:
    $ref: /schemas/types.yaml#/definitions/uint32
    minimum: 0
    maximum: 7
    description: |
      External Output Clock Divider.
      Corresponds to bits [10:8] in register EBI_CTL0.

  tALE:
    $ref: /schemas/types.yaml#/definitions/uint32
    minimum: 0
    maximum: 7
    description: |
      Address Latch Enable (ALE) Hold Time.
      Corresponds to bits [18:16] in register EBI_CTL0.

  tACC:
    $ref: /schemas/types.yaml#/definitions/uint32
    minimum: 0
    maximum: 31
    description: |
      EBI Access Time.
      Corresponds to bits [7:3] in register EBI_TCTLx.

  tAHD:
    $ref: /schemas/types.yaml#/definitions/uint32
    minimum: 0
    maximum: 7
    description: |
      EBI Address Hold Time.
      Corresponds to bits [10:9] in register EBI_TCTLx.

  IDLE:
    $ref: /schemas/types.yaml#/definitions/uint32
    minimum: 0
    maximum: 15
    description: |
      Idle cycle.
      Corresponds to bits [27:24] and [15:12] in register EBI_TCTLx.

required:
  - compatible
  - reg
  - clocks
  - bank
  - busmode
  - csactiveLevel
  - datawidth
  - MCLKDIV
  - tALE
  - tACC
  - tAHD
  - IDLE

additionalProperties: false

examples:
  - |
    #include <dt-bindings/interrupt-controller/arm-gic.h>
    #include <dt-bindings/clock/nuvoton,ma35d1-clk.h>

    ebi0: ebi@40100000 {
        compatible = "nuvoton,ma35d1-ebi";
        reg = <0x0 0x40100000 0x0 0x10>;
        bank = <0>;
        clocks = <&clk EBI_GATE>;
        busmode = <1>; /* Address/Data Bus Separate Mode. 0:Disabled, 1:Enabled */
        csactiveLevel = <0>; /* 0:Low, 1: High */
        datawidth = <1>; /* 0:8bit, 1: 16bit */
        MCLKDIV = <2>; /* 0 ~ 7,EBI_CTL0[10:8] */
        tALE = <1>; /* 0 ~ 7,EBI_CTL0[18:16] */
        tACC = <1>; /* 0 ~ 31, EBI_TCTLx[7:3] */
        tAHD = <1>; /* 0 ~ 7, EBI_TCTLx[10:9] */
        IDLE  = <3>; /* 0 ~ 15, EBI_TCTLx[27:24] and EBI_TCTLx[15:12] */
    };
```

## Documentation/devicetree/bindings/misc/nuvoton,ma35d1-kstore-optee.yaml
```yaml
# SPDX-License-Identifier: (GPL-2.0-only OR BSD-2-Clause)
%YAML 1.2
---
$id: http://devicetree.org/schemas/misc/nuvoton,ma35d1-kstore-optee.yaml#
$schema: http://devicetree.org/meta-schemas/core.yaml#

title: Nuvoton MA35D1 OP-TEE Key Store

maintainers:
  - Nuvoton Technology Corporation <cwweng@nuvoton.com>

description:
  The Nuvoton MA35D1 OP-TEE Key Store provides access to the hardware
  key storage engine through an OP-TEE Trusted Application.

properties:
  compatible:
    enum:
      - nuvoton,ma35d1-kstore-optee
      - nuvoton,ma35d0-kstore-optee
      - nuvoton,ma35h0-kstore-optee

required:
  - compatible

additionalProperties: false

examples:
  - |
    kstore-optee {
        compatible = "nuvoton,ma35d1-kstore-optee";
    };
...
```

## Documentation/devicetree/bindings/misc/nuvoton,ma35d1-kstore.yaml
```yaml
# SPDX-License-Identifier: (GPL-2.0-only OR BSD-2-Clause)
%YAML 1.2
---
$id: http://devicetree.org/schemas/misc/nuvoton,ma35d1-kstore.yaml#
$schema: http://devicetree.org/meta-schemas/core.yaml#

title: Nuvoton MA35D1 Key Store

maintainers:
  - Nuvoton Technology Corporation <cwweng@nuvoton.com>

description:
  The Nuvoton MA35D1 Key Store is a hardware key storage engine found on
  MA35D1, MA35D0 and MA35H0 SoCs.

properties:
  compatible:
    enum:
      - nuvoton,ma35d1-kstore
      - nuvoton,ma35d0-kstore
      - nuvoton,ma35h0-kstore

  reg:
    maxItems: 1

  interrupts:
    maxItems: 1

required:
  - compatible
  - reg
  - interrupts

additionalProperties: false

examples:
  - |
    #include <dt-bindings/interrupt-controller/arm-gic.h>

    kstore: key-store@40340800 {
        compatible = "nuvoton,ma35d1-kstore";
        reg = <0x40340800 0x800>;
        interrupts = <GIC_SPI 41 IRQ_TYPE_LEVEL_HIGH>;
    };
...
```

## Documentation/devicetree/bindings/misc/nuvoton,ma35d1-timer.yaml
```yaml
# SPDX-License-Identifier: (GPL-2.0-only OR BSD-2-Clause)
%YAML 1.2
---
$id: http://devicetree.org/schemas/misc/nuvoton,ma35d1-timer.yaml#
$schema: http://devicetree.org/meta-schemas/core.yaml#

title: Nuvoton MA35D1 Timer Controller

maintainers:
  - Nuvoton Technology Corporation <cwweng@nuvoton.com>

properties:
  compatible:
    enum:
      - nuvoton,ma35d1-timer
      - nuvoton,ma35d0-timer
      - nuvoton,ma35h0-timer

  reg:
    maxItems: 1

  interrupts:
    maxItems: 1

  port-number:
    $ref: /schemas/types.yaml#/definitions/uint32
    description: The hardware index/number of the timer port.
    enum: [0, 1, 2, 3, 4, 5]

  nuvoton,clk:
    $ref: /schemas/types.yaml#/definitions/phandle
    description: Phandle to the main clock controller.

  clocks:
    maxItems: 1

required:
  - compatible
  - reg
  - interrupts
  - port-number
  - clocks

additionalProperties: false

examples:
  - |
    #include <dt-bindings/interrupt-controller/arm-gic.h>
    #include <dt-bindings/clock/nuvoton,ma35d1-clk.h>

    timer0: timer0@40500000 {
        compatible = "nuvoton,ma35d1-timer";
        reg = <0x0 0x40500000 0x0 0x100>;
        interrupts = <GIC_SPI 47 IRQ_TYPE_LEVEL_HIGH>;
        port-number = <0>;
        nuvoton,clk = <&clk>;
        clocks = <&clk TMR0_GATE>;
    };
```

## Documentation/devicetree/bindings/misc/nuvoton,ma35h0-misctrl.yaml
```yaml
# SPDX-License-Identifier: (GPL-2.0-only OR BSD-2-Clause)
%YAML 1.2
---
$id: http://devicetree.org/schemas/misc/nuvoton,ma35h0-misctrl.yaml#
$schema: http://devicetree.org/meta-schemas/core.yaml#

title: Nuvoton MA35H0 Misc Control Driver

maintainers:
  - Nuvoton Technology Corporation <cwweng@nuvoton.com>

description:
  Miscellaneous control interface for the Nuvoton MA35H0 SoC. The driver
  provides a misc device for issuing MA35H0 SiP service calls.

properties:
  compatible:
    const: nuvoton,ma35h0-misctrl

required:
  - compatible

additionalProperties: false

examples:
  - |
    misctrl {
        compatible = "nuvoton,ma35h0-misctrl";
    };
...
```

## Documentation/devicetree/bindings/mmc/nuvoton,ma35d1-sdhci.yaml
```yaml
# SPDX-License-Identifier: (GPL-2.0-only OR BSD-2-Clause)
%YAML 1.2
---
$id: http://devicetree.org/schemas/mmc/nuvoton,ma35d1-sdhci.yaml#
$schema: http://devicetree.org/meta-schemas/core.yaml#

title: Nuvoton MA35 SD/SDIO/MMC Controller

maintainers:
  - Shan-Chun Hung <shanchun1218@gmail.com>

allOf:
  - $ref: sdhci-common.yaml#

properties:
  compatible:
    enum:
      - nuvoton,ma35d0-sdhci
      - nuvoton,ma35d1-sdhci
      - nuvoton,ma35h0-sdhci

  reg:
    maxItems: 1

  interrupts:
    maxItems: 1

  clocks:
    minItems: 1
    maxItems: 2

  clock-names:
    minItems: 1
    items:
      - const: core
      - const: bus

  pinctrl-names:
    minItems: 1
    items:
      - const: default
      - const: state_uhs

  pinctrl-0:
    description:
      Should contain default/high speed pin ctrl.
    maxItems: 1

  pinctrl-1:
    description:
      Should contain uhs mode pin ctrl.
    maxItems: 1

  resets:
    maxItems: 1

  nuvoton,sys:
    $ref: /schemas/types.yaml#/definitions/phandle
    deprecated: true
    description: Legacy phandle to the MA35 system controller.

  nuvoton,ma35d0-sys:
    $ref: /schemas/types.yaml#/definitions/phandle
    description: Phandle to the MA35D0 system controller.

  nuvoton,ma35d1-sys:
    $ref: /schemas/types.yaml#/definitions/phandle
    description: Phandle to the MA35D1 system controller.

  nuvoton,ma35h0-sys:
    $ref: /schemas/types.yaml#/definitions/phandle
    description: Phandle to the MA35H0 system controller.

  dhci-caps-mask:
    $ref: /schemas/types.yaml#/definitions/uint64
    deprecated: true
    description: Legacy misspelling of sdhci-caps-mask.

  sdhci-caps-mask:
    $ref: /schemas/types.yaml#/definitions/uint64

required:
  - compatible
  - reg
  - interrupts
  - clocks
  - clock-names
  - resets

unevaluatedProperties: false

examples:
  - |
    #include <dt-bindings/interrupt-controller/arm-gic.h>
    #include <dt-bindings/clock/nuvoton,ma35d1-clk.h>
    #include <dt-bindings/reset/nuvoton,ma35d1-reset.h>

    soc {
        #address-cells = <2>;
        #size-cells = <2>;
        mmc@40190000 {
            compatible = "nuvoton,ma35d1-sdhci";
            reg = <0x0 0x40190000 0x0 0x2000>;
            interrupts = <GIC_SPI 31 IRQ_TYPE_LEVEL_HIGH>;
            clocks = <&clk SDH1_GATE>;
            pinctrl-names = "default", "state_uhs";
            pinctrl-0 = <&pinctrl_sdhci1>;
            pinctrl-1 = <&pinctrl_sdhci1_uhs>;
            resets = <&sys MA35D1_RESET_SDH1>;
            nuvoton,sys = <&sys>;
            vqmmc-supply = <&sdhci1_vqmmc_regulator>;
            bus-width = <8>;
            max-frequency = <200000000>;
        };
    };
```

## Documentation/devicetree/bindings/regulator/nuvoton,ma35d1-regulator.yaml
```yaml
# SPDX-License-Identifier: GPL-2.0-only
%YAML 1.2
---
$id: http://devicetree.org/schemas/regulator/nuvoton,ma35d1-regulator.yaml#
$schema: http://devicetree.org/meta-schemas/core.yaml#

title: Nuvoton MA35D1/MA35D0/MA35H0 SoC voltage regulator

maintainers:
  - Your Name <your.email@example.com>

description: |
  This binding describes the regulator control interface for Nuvoton
  MA35D1, MA35D0, and MA35H0 platforms. The regulator is controlled
  through a platform-specific secure monitor call interface.

allOf:
  - $ref: /schemas/regulator/regulator.yaml#

properties:
  compatible:
    enum:
      - nuvoton,ma35d1-volt
      - nuvoton,ma35d0-volt
      - nuvoton,ma35h0-volt

required:
  - compatible

unevaluatedProperties: false

examples:
  - |
    regulator {
        compatible = "nuvoton,ma35d1-volt";
        regulator-name = "vdd-sd";
        regulator-min-microvolt = <1800000>;
        regulator-max-microvolt = <3300000>;
    };
...
```

## Documentation/devicetree/bindings/remoteproc/nuvoton,ma35d1-amp.yaml
```yaml
# SPDX-License-Identifier: (GPL-2.0-only OR BSD-2-Clause)
%YAML 1.2
---
$id: http://devicetree.org/schemas/remoteproc/nuvoton,ma35d1-amp.yaml#
$schema: http://devicetree.org/meta-schemas/core.yaml#

title: Nuvoton MA35 AMP rpmsg controller (timer-based IPI)

maintainers:
  - Joey Lu <yclu4@nuvoton.com>

description:
  The MA35 AMP driver provides an rpmsg communication channel between the
  Cortex-A35 Linux host and a bare-metal remote core (Cortex-M4 or second
  A35 core). Inter-processor interrupts are signalled through a pair of
  hardware timers operating in one-shot mode. The driver implements the
  Linux rpmsg bus and exposes character devices under /dev/rpmsg_ctrlX for
  user-space endpoint management.

  The shared memory layout is described by a resource table written by the
  remote firmware into the reserved-memory region. The driver parses this
  table on first IPI to discover vring offsets, buffer sizes and channel
  naming space.

  Supported platforms are MA35D1, MA35D0, and MA35H0.

properties:
  compatible:
    enum:
      - nuvoton,ma35d1-amp
      - nuvoton,ma35d0-amp
      - nuvoton,ma35h0-amp

  memory-region:
    maxItems: 1
    description:
      Phandle to a reserved-memory node shared between the A35 host and
      the remote core. The remote firmware writes a resource table at the
      start of this region describing vring layout and buffer sizes.

  rxipi:
    $ref: /schemas/types.yaml#/definitions/phandle
    description:
      Phandle to the timer node used as the inbound IPI (remote-to-host
      interrupt). The driver maps the timer registers, enables the timer
      interrupt, and requests the IRQ from this node. Typically timer8.

  txipi:
    $ref: /schemas/types.yaml#/definitions/phandle
    description:
      Phandle to the timer node used as the outbound IPI (host-to-remote
      interrupt). The driver maps the timer registers and triggers a
      one-shot count to signal the remote core. Typically timer9.

required:
  - compatible
  - memory-region
  - rxipi
  - txipi

additionalProperties: false

examples:
  - |
    amp: amp {
        compatible = "nuvoton,ma35d1-amp";
        memory-region = <&rpmsg_buf>;
        rxipi = <&timer8>;
        txipi = <&timer9>;
    };
```
