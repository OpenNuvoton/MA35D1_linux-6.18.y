## Documentation/devicetree/bindings/cpufreq/nuvoton,ma35d1-cpufreq.yaml
```yaml
# SPDX-License-Identifier: (GPL-2.0-only OR BSD-2-Clause)
%YAML 1.2
---
$id: http://devicetree.org/schemas/cpufreq/nuvoton,ma35d1-cpufreq.yaml#
$schema: http://devicetree.org/meta-schemas/core.yaml#

title: Nuvoton MA35D1 CPUFreq Driver

maintainers:
  - Nuvoton Technology Corporation <cwweng@nuvoton.com>

description: |
  CPU frequency scaling driver for the Nuvoton MA35D1 SoC.

  The driver controls CPU frequency through Secure Monitor Calls (SMC)
  and accesses the clock controller through the MA35D1 clock syscon.

properties:
  compatible:
    const: nuvoton,ma35d1-cpufreq

required:
  - compatible

additionalProperties: false

examples:
  - |
    cpufreq {
        compatible = "nuvoton,ma35d1-cpufreq";
    };

...
```

## Documentation/devicetree/bindings/cpufreq/nuvoton,ma35h0-cpufreq.yaml
```yaml
# SPDX-License-Identifier: (GPL-2.0-only OR BSD-2-Clause)
%YAML 1.2
---
$id: http://devicetree.org/schemas/cpufreq/nuvoton,ma35h0-cpufreq.yaml#
$schema: http://devicetree.org/meta-schemas/core.yaml#

title: Nuvoton MA35H0 CPUFreq Driver

maintainers:
  - Nuvoton Technology Corporation <cwweng@nuvoton.com>

description: |
  CPU frequency scaling driver for the Nuvoton MA35H0 SoC.

  The driver controls CPU frequency through Secure Monitor Calls (SMC)
  and accesses the MA35H0 clock controller through syscon.

properties:
  compatible:
    const: nuvoton,ma35h0-cpufreq

required:
  - compatible

additionalProperties: false

examples:
  - |
    cpufreq {
        compatible = "nuvoton,ma35h0-cpufreq";
    };

...
```

## Documentation/devicetree/bindings/crypto/nuvoton,ma35d1-crypto-optee.yaml
```yaml
# SPDX-License-Identifier: (GPL-2.0-only OR BSD-2-Clause)
%YAML 1.2
---
$id: http://devicetree.org/schemas/crypto/nuvoton,ma35d1-crypto-optee.yaml#
$schema: http://devicetree.org/meta-schemas/core.yaml#

title: Nuvoton MA35D1 OP-TEE Cryptographic Accelerator

maintainers:
  - Nuvoton Technology Corporation <cwweng@nuvoton.com>

description:
  The Nuvoton MA35D1 OP-TEE cryptographic accelerator interface provides
  access to the hardware crypto engine through an OP-TEE Trusted Application.

properties:
  compatible:
    enum:
      - nuvoton,ma35d1-crypto-optee
      - nuvoton,ma35d0-crypto-optee
      - nuvoton,ma35h0-crypto-optee

required:
  - compatible

additionalProperties: false

examples:
  - |
    crypto-optee {
        compatible = "nuvoton,ma35d1-crypto-optee";
    };
...
```

## Documentation/devicetree/bindings/crypto/nuvoton,ma35d1-crypto.yaml
```yaml
# SPDX-License-Identifier: (GPL-2.0-only OR BSD-2-Clause)
%YAML 1.2
---
$id: http://devicetree.org/schemas/crypto/nuvoton,ma35d1-crypto.yaml#
$schema: http://devicetree.org/meta-schemas/core.yaml#

title: Nuvoton MA35D1 Cryptographic Accelerator

maintainers:
  - Nuvoton Technology Corporation <cwweng@nuvoton.com>

description:
  The Nuvoton MA35D1 cryptographic accelerator provides hardware
  acceleration for AES, SHA, ECC, RSA and random number generation.

properties:
  compatible:
    enum:
      - nuvoton,ma35d1-crypto
      - nuvoton,ma35d0-crypto
      - nuvoton,ma35h0-crypto

  reg:
    maxItems: 1

  interrupts:
    maxItems: 1

  rsa_ioctl:
    $ref: /schemas/types.yaml#/definitions/string
    enum:
      - "yes"
      - "no"
    description:
      Selects the vendor RSA ioctl interface when set to "yes".

  ecc_ioctl:
    $ref: /schemas/types.yaml#/definitions/string
    enum:
      - "yes"
      - "no"
    description:
      Selects the vendor ECC ioctl interface when set to "yes".

required:
  - compatible
  - reg
  - interrupts

additionalProperties: false

examples:
  - |
    #include <dt-bindings/interrupt-controller/arm-gic.h>

    crypto: crypto@40300000 {
        compatible = "nuvoton,ma35d1-crypto";
        reg = <0x40300000 0x1000>;
        interrupts = <GIC_SPI 39 IRQ_TYPE_LEVEL_HIGH>;
        rsa_ioctl = "yes";
        ecc_ioctl = "yes";
    };
...
```

## Documentation/devicetree/bindings/display/nuvoton,ma35d1-dcu.yaml
```yaml
# SPDX-License-Identifier: (GPL-2.0-only OR BSD-2-Clause)
%YAML 1.2
---
$id: http://devicetree.org/schemas/display/nuvoton,ma35d1-dcu.yaml#
$schema: http://devicetree.org/meta-schemas/core.yaml#

title: Nuvoton MA35 Display Controller Unit (DCU)

maintainers:
  - Joey Lu <yclu4@nuvoton.com>

description:
  The MA35 DCU is a display controller supporting up to three hardware
  layers (primary, overlay, cursor) with independent pixel formats and
  blending. It drives a parallel RGB/DPI output bus.

  The driver implements the Linux DRM/KMS subsystem with atomic modesetting.
  The DPI output port connects to a panel or bridge described as a separate
  DT node using the standard DRM bridge/panel OF graph binding.

  The layers child node is required and must contain between 1 and 3 layer
  subnodes. Each layer must declare its type. A cursor layer additionally
  accepts hotspot coordinates.

  An optional reserved-memory region can be provided for framebuffer
  allocation; without it the driver falls back to CMA dynamic allocation.

  Supported on MA35D1, MA35D0, and MA35H0.

properties:
  compatible:
    enum:
      - nuvoton,ma35d1-drm
      - nuvoton,ma35d0-drm
      - nuvoton,ma35h0-drm

  reg:
    maxItems: 1
    description: DCU register range.

  interrupts:
    maxItems: 1
    description: DCU vblank/display interrupt.

  clocks:
    items:
      - description: DCU core gate clock.
      - description: DCU pixel divider clock. The driver calls clk_set_rate()
          on this clock to match the panel pixel clock at mode-set time.

  clock-names:
    items:
      - const: dcu_gate
      - const: dcup_div

  resets:
    maxItems: 1
    description: Reset line for the DCU block.

  memory-region:
    maxItems: 1
    description:
      Optional phandle to a reserved-memory node with compatible
      "shared-dma-pool". When present the driver registers it as the DMA
      memory region for framebuffer allocation. When absent the driver
      falls back to CMA dynamic allocation.

  port:
    $ref: /schemas/graph.yaml#/properties/port
    description:
      DPI output port. The single endpoint connects to the downstream
      panel or bridge node. The driver discovers the bridge via
      devm_drm_of_get_bridge() on port 0, endpoint 0.

  layers:
    type: object
    description:
      Required container node for the hardware display layer subnodes.
      Must have between 1 and 3 child nodes. Each child represents one
      DCU hardware layer.

    properties:
      "#address-cells":
        const: 1
      "#size-cells":
        const: 0

    patternProperties:
      "^layer@[0-9]+$":
        type: object
        description: A single DCU display layer.

        properties:
          reg:
            maxItems: 1
            description: Layer index, must match the unit address.

          layer-id:
            $ref: /schemas/types.yaml#/definitions/uint32
            minimum: 0
            maximum: 2
            description:
              Hardware layer index. 0 is the primary layer, 1 the overlay,
              2 the cursor layer.

          layer-type:
            $ref: /schemas/types.yaml#/definitions/string
            enum:
              - primary
              - overlay
              - cursor
            description:
              Functional role of this layer. Exactly one layer must be
              "primary". At most one layer may be "cursor".

        required:
          - reg
          - layer-id
          - layer-type

        additionalProperties: false

    required:
      - "#address-cells"
      - "#size-cells"

    additionalProperties: false

required:
  - compatible
  - reg
  - interrupts
  - clocks
  - clock-names
  - resets
  - layers

additionalProperties: false

examples:
  - |
    #include <dt-bindings/interrupt-controller/arm-gic.h>
    #include <dt-bindings/clock/nuvoton,ma35d1-clk.h>
    #include <dt-bindings/reset/nuvoton,ma35d1-reset.h>

    display@40260000 {
        compatible = "nuvoton,ma35d1-drm";
        reg = <0x40260000 0x2000>;
        interrupts = <GIC_SPI 20 IRQ_TYPE_LEVEL_HIGH>;
        clocks = <&clk DCU_GATE>, <&clk DCUP_DIV>;
        clock-names = "dcu_gate", "dcup_div";
        resets = <&reset MA35D1_RESET_DISP>;

        layers {
            #address-cells = <1>;
            #size-cells = <0>;

            layer@0 {
                reg = <0>;
                layer-id = <0>;
                layer-type = "primary";
            };

            layer@1 {
                reg = <1>;
                layer-id = <1>;
                layer-type = "overlay";
            };

            layer@2 {
                reg = <2>;
                layer-id = <2>;
                layer-type = "cursor";
            };
        };

        port {
            #address-cells = <1>;
            #size-cells = <0>;
            dpi_out: endpoint@0 {
                reg = <0>;
                remote-endpoint = <&panel_in>;
            };
        };
    };
```

## Documentation/devicetree/bindings/dma/nuvoton,ma35d1-dma.yaml
```yaml
# SPDX-License-Identifier: (GPL-2.0-only OR BSD-2-Clause)
%YAML 1.2
---
$id: http://devicetree.org/schemas/dma/nuvoton,ma35d1-dma.yaml#
$schema: http://devicetree.org/meta-schemas/core.yaml#

title: Nuvoton MA35 Series PDMA Controller

description: |
  The MA35D0, MA35D1, and MA35H0 SoCs provide four peripheral DMA controllers
  for memory-to-memory and peripheral data transfers. Each controller supports
  10 channels.

maintainers:
  - Shan-Chun Hung <schung@Nuvoton.com>

allOf:
  - $ref: dma-controller.yaml#

properties:
  compatible:
    enum:
      - nuvoton,ma35d0-dma
      - nuvoton,ma35d1-dma
      - nuvoton,ma35h0-dma

  reg:
    maxItems: 1

  clocks:
    maxItems: 1

  interrupts:
    maxItems: 1

  "#dma-cells":
    const: 1

  dma-channels:
    minimum: 1
    maximum: 10

additionalProperties: false

required:
  - compatible
  - reg
  - clocks
  - interrupts
  - "#dma-cells"
  - dma-channels

examples:
  - |
    #include <dt-bindings/clock/nuvoton,ma35d1-clk.h>
    #include <dt-bindings/interrupt-controller/arm-gic.h>
    pdma0: dma-controller@40080000 {
        compatible = "nuvoton,ma35d1-dma";
        reg = <0x40080000 0x2000>;
        interrupts = <GIC_SPI 18 IRQ_TYPE_LEVEL_HIGH>;
        clocks = <&clk PDMA0_GATE>;
        #dma-cells = <1>;
        dma-channels = <10>;
    };
```

## Documentation/devicetree/bindings/hwlock/nuvoton,ma35d1-hwsem.yaml
```yaml
# SPDX-License-Identifier: (GPL-2.0-only OR BSD-2-Clause)
%YAML 1.2
---
$id: http://devicetree.org/schemas/hwlock/nuvoton,ma35d1-hwsem.yaml#
$schema: http://devicetree.org/meta-schemas/core.yaml#

title: Nuvoton MA35 Hardware Semaphore (hwspinlock)

maintainers:
  - Joey Lu <yclu4@nuvoton.com>

description:
  The MA35 hardware semaphore provides 8 mutex locks (SEM0-SEM7) shared
  between the Cortex-A35 host and the Cortex-M4 remote core. Each lock
  uses a fixed key (0x5500) combined with a core ID to implement a
  test-and-set protocol in a single register write/read cycle.

  The semaphore registers begin at offset 0x20 from the base address
  (8 x 4-byte words of prefix registers before SEM0). The driver
  registers all 8 locks with the Linux hwspinlock framework starting at
  base ID 0.

  The clock gate must be enabled via the system management (syscon)
  register unlock sequence before the clock can be prepared.

  Supported on MA35D1, MA35D0, and MA35H0.

properties:
  compatible:
    enum:
      - nuvoton,ma35d1-hwsem
      - nuvoton,ma35d0-hwsem
      - nuvoton,ma35h0-hwsem

  reg:
    maxItems: 1
    description:
      Register range of the hardware semaphore block. Must cover at least
      the 8 prefix registers plus 8 semaphore registers (0x40 bytes total).

  clocks:
    maxItems: 1
    description: Hardware semaphore gate clock.

  clock-names:
    items:
      - const: hws_gate

  interrupts:
    maxItems: 1
    description:
      Combined interrupt line for all 8 semaphore channels. Used by the
      AMP-M driver (ampm) to receive inbound inter-processor notifications
      via hwsem acquire/release pulses. Optional when the semaphore is used
      purely as a mutex (hwspinlock_lock/trylock) without IPI signalling.

  nuvoton,sys:
    $ref: /schemas/types.yaml#/definitions/phandle
    description:
      Phandle to the system management syscon. Required to perform the
      register unlock sequence (write 0x59, 0x16, 0x88 to SYS_RLKTZNS)
      before enabling the hwsem clock gate.

  "#hwsem-cells":
    const: 1
    description:
      One cell specifying the semaphore channel index (0-7). Used by
      consumers such as the ampm driver to reference individual channels
      via the rxipi and txipi properties.

required:
  - compatible
  - reg
  - clocks
  - clock-names
  - nuvoton,sys
  - "#hwsem-cells"

additionalProperties: false

examples:
  - |
    #include <dt-bindings/interrupt-controller/arm-gic.h>
    #include <dt-bindings/clock/nuvoton,ma35d1-clk.h>

    hwspinlock@40380000 {
        compatible = "nuvoton,ma35d1-hwsem";
        reg = <0x40380000 0x1000>;
        clocks = <&clk HWS_GATE>;
        clock-names = "hws_gate";
        interrupts = <GIC_SPI 2 IRQ_TYPE_LEVEL_HIGH>;
        nuvoton,sys = <&sys>;
        #hwsem-cells = <1>;
    };
```

## Documentation/devicetree/bindings/i2c/nuvoton,ma35d1-i2c.yaml
```yaml
# SPDX-License-Identifier: (GPL-2.0-only OR BSD-2-Clause)
%YAML 1.2
---
$id: http://devicetree.org/schemas/i2c/nuvoton,ma35d1-i2c.yaml#
$schema: http://devicetree.org/meta-schemas/core.yaml#

title: Nuvoton MA35D1 I2C Controller

maintainers:
  - Nuvoton Technology Corporation <cwweng@nuvoton.com>

description:
  The Nuvoton MA35D1 I2C controller supports controller and optional target mode.

allOf:
  - $ref: /schemas/i2c/i2c-controller.yaml#

properties:
  compatible:
    enum:
      - nuvoton,ma35d1-i2c
      - nuvoton,ma35d0-i2c
      - nuvoton,ma35h0-i2c

  reg:
    maxItems: 1

  interrupts:
    maxItems: 1

  clocks:
    maxItems: 1

  clock-frequency:
    description:
      Desired I2C bus clock frequency in Hz. The absence of this property
      indicates the default frequency 100 kHz.

  resets:
    maxItems: 1

  nuvoton,nfcnt:
    $ref: /schemas/types.yaml#/definitions/uint32
    minimum: 0
    maximum: 15
    default: 0
    description:
      Noise filter count field for CLKDIV[15:12]. This is a board-specific
      property that depends on PCB layout / bus noise conditions and should
      only be set (typically as a board-level override) on boards that
      require noise filtering. If omitted, the driver programs this field
      to 0.

required:
  - compatible
  - reg
  - interrupts
  - clocks
  - resets

unevaluatedProperties: false

examples:
  - |
    #include <dt-bindings/interrupt-controller/arm-gic.h>
    #include <dt-bindings/clock/nuvoton,ma35d1-clk.h>
    #include <dt-bindings/reset/nuvoton,ma35d1-reset.h>

    i2c0: i2c@40800000 {
      compatible = "nuvoton,ma35d1-i2c";
      reg = <0x40800000 0x1000>;
      interrupts = <GIC_SPI 13 IRQ_TYPE_LEVEL_HIGH>;
      clocks = <&clk I2C0_GATE>;
      clock-frequency = <100000>;
      resets = <&sys MA35D1_RESET_I2C0>;
      #address-cells = <1>;
      #size-cells = <0>;
    };
```
