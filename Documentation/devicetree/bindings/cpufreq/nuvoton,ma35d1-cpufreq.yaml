## Documentation/devicetree/bindings/iio/adc/nuvoton,ma35d1-adc.yaml
```yaml
# SPDX-License-Identifier: (GPL-2.0-only OR BSD-2-Clause)
%YAML 1.2
---
$id: http://devicetree.org/schemas/iio/adc/nuvoton,ma35d1-adc.yaml#
$schema: http://devicetree.org/meta-schemas/core.yaml#

title: Nuvoton MA35 IIO ADC

maintainers:
  - Joey Lu <yclu4@nuvoton.com>

description:
  The MA35 ADC is a 12-bit successive-approximation resistive ADC with
  8 single-ended input channels (CH0-CH7). It supports normal conversion
  mode via the IIO subsystem and triggered buffer mode for continuous
  sampling.

  This binding covers the IIO-only ADC driver (nuvoton,ma35d1-adc).
  For the hybrid ADC/touchscreen driver that drives the same hardware,
  see nuvoton,ma35d1-ts.yaml.

  Supported on MA35D1, MA35D0, and MA35H0.

properties:
  compatible:
    enum:
      - nuvoton,ma35d1-adc
      - nuvoton,ma35d0-adc
      - nuvoton,ma35h0-adc

  reg:
    maxItems: 1

  interrupts:
    maxItems: 1

  clocks:
    maxItems: 1
    description: ADC gate clock.

  clock-names:
    items:
      - const: adc_gate

  clock-rate:
    $ref: /schemas/types.yaml#/definitions/uint32
    description:
      Target ADC clock rate in Hz set via clk_set_rate(). If omitted the
      driver defaults to 100 MHz. The hardware SPEED bit is cleared when
      clock-rate >= nuvoton,min-clock-frequency and set otherwise.

  nuvoton,adc-vref:
    $ref: /schemas/types.yaml#/definitions/uint32
    description:
      ADC reference voltage in millivolts. Used to compute the IIO scale
      factor reported via IIO_CHAN_INFO_SCALE. Required.

  nuvoton,min-clock-frequency:
    $ref: /schemas/types.yaml#/definitions/uint32
    description:
      Minimum acceptable ADC clock frequency in Hz. When clock-rate is
      below this value the hardware SPEED bit is set (low-speed mode).

  nuvoton,max-clock-frequency:
    $ref: /schemas/types.yaml#/definitions/uint32
    description:
      Maximum acceptable ADC clock frequency in Hz. Informational; used
      by the driver for range checking.

  "#io-channel-cells":
    const: 1
    description:
      One cell specifying the ADC channel index (0-7). Required when this
      node is referenced as an IIO provider by other nodes.

required:
  - compatible
  - reg
  - interrupts
  - clocks
  - clock-names
  - nuvoton,adc-vref

additionalProperties: false

examples:
  - |
    #include <dt-bindings/interrupt-controller/arm-gic.h>
    #include <dt-bindings/clock/nuvoton,ma35d1-clk.h>

    adc@40420000 {
        compatible = "nuvoton,ma35d1-adc";
        reg = <0x40420000 0x500>;
        interrupts = <GIC_SPI 80 IRQ_TYPE_LEVEL_HIGH>;
        clocks = <&clk ADC_GATE>;
        clock-names = "adc_gate";
        clock-rate = <200000>;

        nuvoton,adc-vref = <3300>;
        nuvoton,min-clock-frequency = <3200000>;
        nuvoton,max-clock-frequency = <16000000>;
        #io-channel-cells = <1>;
    };
```

## Documentation/devicetree/bindings/iio/adc/nuvoton,ma35d1-eadc.yaml
```yaml
# SPDX-License-Identifier: (GPL-2.0-only OR BSD-2-Clause)
%YAML 1.2
---
$id: http://devicetree.org/schemas/iio/adc/nuvoton,ma35d1-eadc.yaml#
$schema: http://devicetree.org/meta-schemas/core.yaml#

title: Nuvoton MA35D1 Enhanced Analog to Digital Converter

maintainers:
  - Chi-Wen Weng <cwweng@nuvoton.com>

description: |
  The Nuvoton MA35D1 EADC is a 12-bit converter. The Linux 6.18
  driver describes enabled inputs with the eadc-channels property.

properties:
  compatible:
    const: nuvoton,ma35d1-eadc

  reg:
    maxItems: 1

  interrupts:
    maxItems: 1

  clocks:
    maxItems: 1

  clock-names:
    items:
      - const: eadc_gate

  eadc-frequency:
    $ref: /schemas/types.yaml#/definitions/uint32
    description: EADC clock frequency in Hz.

  eadc-channels:
    $ref: /schemas/types.yaml#/definitions/uint32-array
    minItems: 1
    maxItems: 8
    items:
      minimum: 0
      maximum: 7
    description: Enabled single-ended EADC channel numbers.

  eadc-diff-channels:
    $ref: /schemas/types.yaml#/definitions/uint32-array
    minItems: 2
    maxItems: 16
    items:
      minimum: 0
      maximum: 7
    description: Optional differential channel pairs (two values per pair).

  use_pdma:
    $ref: /schemas/types.yaml#/definitions/uint32
    enum: [0, 1]

  dmas:
    maxItems: 1

  dma-names:
    items:
      - const: rx

  pdma_reqsel_rx:
    $ref: /schemas/types.yaml#/definitions/uint32

required:
  - compatible
  - reg
  - interrupts
  - clocks
  - clock-names
  - eadc-frequency
  - eadc-channels

additionalProperties: false
```

## Documentation/devicetree/bindings/input/nuvoton,ma35d1-kpi.yaml
```yaml
# SPDX-License-Identifier: (GPL-2.0-only OR BSD-2-Clause)
%YAML 1.2
---
$id: http://devicetree.org/schemas/input/nuvoton,ma35d1-kpi.yaml#
$schema: http://devicetree.org/meta-schemas/core.yaml#

title: Nuvoton MA35 Series Keypad Controller

maintainers:
  - Nuvoton Technology Corporation <cwweng@nuvoton.com>

allOf:
  - $ref: matrix-keymap.yaml#

properties:
  compatible:
    enum:
      - nuvoton,ma35d1-kpi
      - nuvoton,ma35d0-kpi
      - nuvoton,ma35h0-kpi

  reg:
    maxItems: 1

  interrupts:
    maxItems: 1

  clocks:
    maxItems: 1

  assigned-clocks:
    maxItems: 1

  assigned-clock-parents:
    maxItems: 1

  debounce-period:
    description: |
      Debounce period setting for key scan.
        0  = disable debounce
        3  = debounce period is 8 clocks
        4  = debounce period is 16 clocks
        5  = debounce period is 32 clocks
        6  = debounce period is 64 clocks
        7  = debounce period is 128 clocks
        8  = debounce period is 256 clocks
        9  = debounce period is 512 clocks
        10 = debounce period is 1024 clocks
        11 = debounce period is 2048 clocks
        12 = debounce period is 4096 clocks
        13 = debounce period is 8192 clocks
    $ref: /schemas/types.yaml#/definitions/uint32
    minimum: 0
    maximum: 13

  pre-scale:
    description: |
      Pre-scale value, ranging from 1 to 256.
    $ref: /schemas/types.yaml#/definitions/uint32
    minimum: 1
    maximum: 256

  pre-scalediv:
    description: |
      Pre-scale divider value, ranging from 1 to 256.
    $ref: /schemas/types.yaml#/definitions/uint32
    minimum: 1
    maximum: 256

required:
  - compatible
  - reg
  - interrupts
  - clocks
  - keypad,num-rows
  - keypad,num-columns
  - linux,keymap

unevaluatedProperties: false

examples:
  - |
    #include <dt-bindings/interrupt-controller/arm-gic.h>
    #include <dt-bindings/input/input.h>
    #include <dt-bindings/input/matrix-keymap.h>

    keypad@404a0000 {
        compatible = "nuvoton,ma35d1-kpi";
        reg = <0x0 0x404a0000 0x0 0x10000>;
        interrupts = <GIC_SPI 79 IRQ_TYPE_LEVEL_HIGH>;
        clocks = <&clk KPI_GATE>;
        assigned-clocks = <&clk KPI_MUX>;
        assigned-clock-parents = <&clk HXT>;
        keypad,num-rows = <4>;
        keypad,num-columns = <4>;
        linux,keymap = 
            MATRIX_KEY(0x00, 0x02, KEY_F)
            MATRIX_KEY(0x00, 0x03, KEY_HOME)
            MATRIX_KEY(0x01, 0x00, KEY_A)
            MATRIX_KEY(0x01, 0x01, KEY_1)
        >;
        debounce-period = <1>;
        pre-scale = <1>;
        pre-scalediv = <32>;
        status = "okay";
    };
```

## Documentation/devicetree/bindings/input/touchscreen/nuvoton,ma35d1-ts.yaml
```yaml
# SPDX-License-Identifier: (GPL-2.0-only OR BSD-2-Clause)
%YAML 1.2
---
$id: http://devicetree.org/schemas/input/touchscreen/nuvoton,ma35d1-ts.yaml#
$schema: http://devicetree.org/meta-schemas/core.yaml#

title: Nuvoton MA35 Hybrid ADC / Resistive Touchscreen

maintainers:
  - Joey Lu <yclu4@nuvoton.com>

description:
  The MA35 hybrid ADC/touchscreen driver drives the same 12-bit ADC
  hardware as the IIO-only driver (nuvoton,ma35d1-adc) but also supports
  a resistive touchscreen panel connected to the ADC inputs.

  Both functions are controlled by the same hardware block at the same
  base address. The compatible string selects which driver is loaded.
  Use nuvoton,ma35d1-ts when touchscreen support is needed (with or
  without simultaneous IIO channel access); use nuvoton,ma35d1-adc for
  IIO-only operation.

  Touchscreen wiring modes supported are 4-wire (ts-type = 4, uses
  CH0-CH3) and 5-wire (ts-type = 5, uses CH0-CH2 plus the 5th wire
  signal). In 4-wire mode all channels CH4-CH7 remain available for
  IIO; in 5-wire mode CH3-CH7 remain available.

  Wakeup from suspend via pen-down detection is optionally supported
  when enable-wakeup is present.

  Supported on MA35D1, MA35D0, and MA35H0.

properties:
  compatible:
    enum:
      - nuvoton,ma35d1-ts
      - nuvoton,ma35d0-ts
      - nuvoton,ma35h0-ts

  reg:
    maxItems: 1

  interrupts:
    maxItems: 1

  clocks:
    maxItems: 1
    description: ADC gate clock.

  clock-names:
    items:
      - const: adc_gate

  clock-rate:
    $ref: /schemas/types.yaml#/definitions/uint32
    description:
      Target ADC clock rate in Hz set via clk_set_rate(). If omitted the
      driver defaults to 1 MHz. The hardware SPEED bit is set when
      clock-rate < 200000 Hz.

  enable-iio:
    type: boolean
    description:
      When present, register an IIO device alongside the touchscreen.
      IIO channels available depend on ts-type; touchscreen channels
      are excluded from the IIO channel mask.

  enable-ts:
    type: boolean
    description:
      When present, register a Linux input device for touchscreen events.
      Requires ts-type to also be set.

  enable-wakeup:
    type: boolean
    description:
      When present, configure pen-down detection as a system wakeup
      source during suspend. The ADC interrupt is set as a wakeup IRQ.

  ts-type:
    $ref: /schemas/types.yaml#/definitions/uint32
    enum: [4, 5]
    description:
      Resistive touchscreen wiring type. 4 selects 4-wire mode (X+, X-,
      Y+, Y- on CH0-CH3); 5 selects 5-wire mode (uses CH0-CH2 plus the
      additional wire, with pen-up detection via PEUEF interrupt). If
      enable-ts is set and ts-type is absent the driver defaults to 4.

  ts-pressure-threshold:
    $ref: /schemas/types.yaml#/definitions/uint32
    description:
      Minimum Z-pressure value (0-4095) below which a touch is considered
      a lift-off in 4-wire mode. Compared against the four Z-sort registers
      (REG_ADC_ZSORT0-3). Defaults to 20 if absent.

  ts-convert-time:
    $ref: /schemas/types.yaml#/definitions/uint32
    description:
      Number of 5 ms sampling periods to wait without a valid pressure
      reading before transitioning back to pen-down detection in 4-wire
      mode. Defaults to 10 if absent.

  "#io-channel-cells":
    const: 1
    description:
      One cell specifying the ADC channel index (0-7). Required when this
      node is referenced as an IIO provider by other nodes.

required:
  - compatible
  - reg
  - interrupts
  - clocks
  - clock-names

additionalProperties: false

examples:
  - |
    #include <dt-bindings/interrupt-controller/arm-gic.h>
    #include <dt-bindings/clock/nuvoton,ma35d1-clk.h>

    adc@40420000 {
        compatible = "nuvoton,ma35d1-ts";
        reg = <0x40420000 0x500>;
        interrupts = <GIC_SPI 80 IRQ_TYPE_LEVEL_HIGH>;
        clocks = <&clk ADC_GATE>;
        clock-names = "adc_gate";
        clock-rate = <200000>;

        enable-iio;
        enable-ts;
        ts-type = <4>;
        ts-pressure-threshold = <20>;
        ts-convert-time = <10>;

        #io-channel-cells = <1>;
    };
```

## Documentation/devicetree/bindings/mailbox/nuvoton,ma35-wormhole.yaml
```yaml
# SPDX-License-Identifier: (GPL-2.0-only OR BSD-2-Clause)
%YAML 1.2
---
$id: http://devicetree.org/schemas/mailbox/nuvoton,ma35-wormhole.yaml#
$schema: http://devicetree.org/meta-schemas/core.yaml#

title: Nuvoton MA35 Wormhole Mailbox Controller

maintainers:
  - Chi-Wen Weng <cwweng@nuvoton.com>

properties:
  compatible:
    enum:
      - nuvoton,ma35d0-wormhole
      - nuvoton,ma35d1-wormhole
      - nuvoton,ma35h0-wormhole

  reg:
    maxItems: 1

  clocks:
    maxItems: 1

  clock-names:
    const: wh0_gate

  interrupts:
    maxItems: 1

  '#mbox-cells':
    const: 1

  wakeup-source: true

  enable-wakeup:
    type: boolean
    deprecated: true
    description: Legacy property enabling wakeup from mailbox interrupts.

required:
  - compatible
  - reg
  - clocks
  - clock-names
  - interrupts
  - '#mbox-cells'

additionalProperties: false

examples:
  - |
    mailbox@403a0000 {
        compatible = "nuvoton,ma35d1-wormhole";
        reg = <0x403a0000 0x1000>;
        clocks = <&clk 1>;
        clock-names = "wh0_gate";
        interrupts = <4>;
        #mbox-cells = <1>;
        wakeup-source;
    };
```

## Documentation/devicetree/bindings/media/nuvoton,ma35-vc8k.yaml
```yaml
# SPDX-License-Identifier: (GPL-2.0-only OR BSD-2-Clause)
%YAML 1.2
---
$id: http://devicetree.org/schemas/media/nuvoton,ma35-vc8k.yaml#
$schema: http://devicetree.org/meta-schemas/core.yaml#

title: Nuvoton MA35 VC8000 Video Codec

maintainers:
  - Chi-Wen Weng <cwweng@nuvoton.com>

properties:
  compatible:
    enum:
      - nuvoton,ma35d0-vc8k
      - nuvoton,ma35d1-vc8k
      - nuvoton,ma35h0-vc8k
  reg:
    maxItems: 1
  clocks:
    maxItems: 1
  interrupts:
    maxItems: 1
  resets:
    maxItems: 1
  nuvoton,sys:
    $ref: /schemas/types.yaml#/definitions/phandle
    description: Phandle to the MA35 system register syscon.
  memory-region:
    maxItems: 1
  pp_out_enable:
    enum: [yes, no]
  pp_wait_vsync:
    $ref: /schemas/types.yaml#/definitions/uint32
  debug_level:
    $ref: /schemas/types.yaml#/definitions/uint32
  fb_width:
    $ref: /schemas/types.yaml#/definitions/uint32
  fb_height:
    $ref: /schemas/types.yaml#/definitions/uint32
  fb_fmt:
    enum: [RGB888, RGB565, YUV420P]
  use_dev_coherent:
    $ref: /schemas/types.yaml#/definitions/uint32
    enum: [0, 1]

required:
  - compatible
  - reg
  - clocks
  - interrupts

additionalProperties: false
```

## Documentation/devicetree/bindings/media/nuvoton,ma35d1-ccap.yaml
```yaml
# SPDX-License-Identifier: (GPL-2.0-only OR BSD-2-Clause)
%YAML 1.2
---
$id: http://devicetree.org/schemas/media/nuvoton,ma35d1-ccap.yaml#
$schema: http://devicetree.org/meta-schemas/core.yaml#

title: Nuvoton MA35D1 Camera Capture Interface Controller (CCAP)

maintainers:
  - Chi-Wen Weng <cwweng@nuvoton.com>

description: |
  The Camera Capture Interface Controller (CCAP) captures image data from
  a sensor, processes the image stream, and uses an embedded DMA engine to
  move data from internal FIFO to system memory through the AHB bus.

properties:
  compatible:
    enum:
      - nuvoton,ma35d0-ccap
      - nuvoton,ma35d1-ccap
      - nuvoton,ma35h0-ccap

  reg:
    maxItems: 1

  interrupts:
    maxItems: 1

  clocks:
    maxItems: 1

  clock-names:
    items:
      - const: core

  clock-frequency:
    description: Input sensor clock frequency in Hz.
    minimum: 1

  port:
    $ref: /schemas/graph.yaml#/$defs/port-base
    unevaluatedProperties: false
    properties:
      endpoint:
        $ref: /schemas/media/video-interfaces.yaml#

required:
  - compatible
  - reg
  - interrupts

additionalProperties: false

examples:
  - |
    #include <dt-bindings/interrupt-controller/arm-gic.h>
    #include <dt-bindings/clock/nuvoton,ma35d1-clk.h>
    ccap0: ccap@40240000 {
      compatible = "nuvoton,ma35d1-ccap";
      reg = <0x40240000 0x2000>;
      interrupts = <GIC_SPI 21 IRQ_TYPE_LEVEL_HIGH>;
      clocks = <&clk CCAP0_GATE>;
      clock-names = "core";
      clock-frequency = <12000000>;
      status = "okay";

      port {
        #address-cells = <1>;
        #size-cells = <0>;

        ccap0_1: endpoint {
          remote-endpoint = <&nt99141_0>;
          bus-type = <5>;
          bus-width = <8>;
          hsync-active = <0>;
          vsync-active = <0>;
          pclk-sample = <1>;
        };
      };
    };

...
```
