## drivers/gpu/drm/nuvoton/Kconfig
```kconfig
config DRM_MA35
	tristate "DRM support for Nuvoton MA35 family SoCs"
	default ARCH_MA35D1
	depends on DRM
	depends on OF && (ARCH_MA35D1 || ARCH_MA35D0 || ARCH_MA35H0 || COMPILE_TEST)
	select DRM_KMS_HELPER
	select DRM_KMS_DMA_HELPER
	select DRM_GEM_DMA_HELPER
	select REGMAP
	select REGMAP_MMIO
	help
	  DRM display driver for display controller on Nuvoton MA35 family SoCs.
```

## drivers/media/platform/nuvoton/Kconfig
```kconfig
# SPDX-License-Identifier: GPL-2.0-only

comment "MA35 media platform drivers"

config VIDEO_MA35D1_CAMERA
	tristate "MA35D1 camera controller support"
	depends on MEDIA_CAMERA_SUPPORT
	depends on VIDEO_DEV && I2C && VIDEO_V4L2_I2C && MEDIA_CONTROLLER
	depends on ARCH_MA35D1
	select VIDEOBUF2_DMA_CONTIG
	select V4L2_FWNODE
	help
	  MA35D1 camera

config VIDEO_MA35D0_CAMERA
	tristate "MA35D0 camera controller support"
	depends on MEDIA_CAMERA_SUPPORT
	depends on VIDEO_DEV && I2C && VIDEO_V4L2_I2C && MEDIA_CONTROLLER
	depends on ARCH_MA35D0
	select VIDEOBUF2_DMA_CONTIG
	select V4L2_FWNODE
	help
	  MA35D0 camera

config VIDEO_MA35H0_CAMERA
	tristate "MA35H0 camera controller support"
	depends on MEDIA_CAMERA_SUPPORT
	depends on VIDEO_DEV && I2C && VIDEO_V4L2_I2C && MEDIA_CONTROLLER
	depends on ARCH_MA35H0
	select VIDEOBUF2_DMA_CONTIG
	select V4L2_FWNODE
	help
	  MA35H0 camera
```
